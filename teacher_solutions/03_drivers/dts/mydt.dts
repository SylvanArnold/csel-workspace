/dts-v1/;

#include "allwinner/sun50i-h5-nanopi-neo-plus2.dts"

/ {
        /delete-node/ leds;

        mydevice {
                compatible = "mydevice";
                attribute = "text";
        };
};
